## config/boards/shields/charliesweep/Kconfig.defconfig
```kconfig
# Copyright (c) 2020 The ZMK Contributors
# SPDX-License-Identifier: MIT

if SHIELD_CHARLIESWEEP_LEFT

config ZMK_KEYBOARD_NAME
	default "charliesweep"

config ZMK_SPLIT_ROLE_CENTRAL
	default y

endif

if SHIELD_CHARLIESWEEP_LEFT || SHIELD_CHARLIESWEEP_RIGHT

config ZMK_SPLIT
	default y

endif
```

## config/boards/shields/charliesweep/Kconfig.shield
```kconfig
# Copyright (c) 2020 The ZMK Contributors
# SPDX-License-Identifier: MIT

config SHIELD_CHARLIESWEEP_LEFT
	def_bool $(shields_list_contains,charliesweep_left)

config SHIELD_CHARLIESWEEP_RIGHT
	def_bool $(shields_list_contains,charliesweep_right)
```
